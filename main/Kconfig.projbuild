## main/Kconfig.projbuild
```kconfig
menu "Configuracoes da Telemetria"

    config TELEMETRY_SERVER_URL
        string "URL do Servidor de Telemetria"
        default "http://ENDERECO_DO_SERVER/api/compressor"
        help
            URL completa do endpoint para envio dos dados HTTP POST.

    config TELEMETRY_SEND_INTERVAL_MS
        int "Intervalo de leitura dos sensores (ms)"
        default 5000
        range 1000 600000
        help
            Frequencia em milissegundos entre as leituras dos sensores.

    config TELEMETRY_BATCH_INTERVAL_MS
        int "Intervalo do lote de telemetria (ms)"
        default 300000
        range 10000 3600000
        help
            Tempo máximo em milissegundos até enviar o lote acumulado.

endmenu
```

## sdkconfig.defaults
```kconfig
CONFIG_IDF_TARGET="esp32"
CONFIG_ESPTOOLPY_FLASHSIZE_4MB=y
CONFIG_PARTITION_TABLE_SINGLE_APP_LARGE=y
CONFIG_MBEDTLS_CERTIFICATE_BUNDLE=y
CONFIG_MBEDTLS_CERTIFICATE_BUNDLE_DEFAULT_FULL=y
CONFIG_TELEMETRY_SERVER_URL="https://darkblue-viper-448014.hostingersite.com/"
```
